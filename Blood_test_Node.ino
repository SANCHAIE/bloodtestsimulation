#define LCD_BACKLIGHT  4
#define LCD_CS         16
#define LCD_DC         15
#define LCD_RST        5
#define BUTTON_PIN     2   // GPIO2 for normal button input
#define OTA_BUTTON_PIN 0   // GPIO0 for OTA update trigger

#include <TaskScheduler.h>
#include "ST7567_FB.h"
#include <SPI.h>
#include <ESP8266WiFi.h>
#include <espnow.h>

#if defined(ESP8266)
  #include <ESP8266WiFi.h>
  #include <WiFiClient.h>
  #include <ESP8266WebServer.h>
#elif defined(ESP32)
  #include <WiFi.h>
  #include <WiFiClient.h>
  #include <WebServer.h>
#elif defined(TARGET_RP2040)
  #include <WiFi.h>
  #include <WebServer.h>
#endif

#include <ElegantOTA.h>
#include "c64enh_font.h"
// LCD Object
ST7567_FB lcd(LCD_DC, LCD_RST, LCD_CS);

const char* ssid = "AKKARACHAI_2.4G";
const char* password = "Hi@0824191956";

#if defined(ESP8266)
  ESP8266WebServer server(80);
#elif defined(ESP32)
  WebServer server(80);
#elif defined(TARGET_RP2040)
  WebServer server(80);
#endif

typedef struct struct_message {
    String time;
    String blood;
} struct_message;

struct_message myData;
// OTA Callbacks
void onOTAStart() { Serial.println("OTA update started!"); }
void onOTAProgress(size_t current, size_t final) { Serial.printf("OTA Progress: %u bytes of %u bytes\n", current, final); }
void onOTAEnd(bool success) { Serial.println(success ? "OTA update finished successfully!" : "OTA update failed!"); }

// LCD Bitmaps
const uint8_t Black_Strip_Bitmap[] PROGMEM = {
    128, 64,  // Width and height of the bitmap
	0x00, 0x00, 0x00, 0x00, 0x00, 0x00, 0x00, 0x00, 0x00, 0x00, 0x00, 0x00, 0x00, 0x00, 0x00, 0x00, 
	0x00, 0x00, 0x00, 0x00, 0x00, 0x00, 0x00, 0x00, 0x00, 0x00, 0x00, 0x00, 0x00, 0x00, 0x00, 0x00, 
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	0x00, 0x00, 0x00, 0x00, 0x00, 0x00, 0x00, 0x00, 0x00, 0x00, 0x00, 0x00, 0x00, 0x00, 0x00, 0x00
};
const uint8_t Blood[] PROGMEM = { 128, 64, 
	0x00, 0x00, 0x00, 0x00, 0x00, 0x00, 0x00, 0x00, 0x00, 0x00, 0x00, 0x00, 0x00, 0x00, 0x00, 0x00, 
	0x00, 0x00, 0x00, 0x00, 0x00, 0x00, 0x00, 0x00, 0x00, 0x00, 0x00, 0x00, 0x00, 0x00, 0x00, 0x00, 
	0x00, 0x00, 0x00, 0x00, 0x00, 0x00, 0x00, 0x00, 0x00, 0x00, 0x00, 0x00, 0x00, 0x00, 0x00, 0x00, 
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	0x00, 0x00, 0x00, 0x00, 0x00, 0x00, 0x00, 0x00, 0x00, 0x00, 0x00, 0x00, 0x00, 0x00, 0x00, 0x00
};

const uint8_t check[] PROGMEM = {
    128, 64,  // Width and height of the bitmap
	0x00, 0x00, 0x00, 0x00, 0x00, 0x00, 0x00, 0x00, 0x00, 0x00, 0x00, 0x00, 0x00, 0x00, 0x00, 0x00, 
	0x00, 0x00, 0x00, 0x00, 0x00, 0x00, 0x00, 0x00, 0x00, 0x00, 0x00, 0x00, 0x00, 0x00, 0x00, 0x00, 
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	0x00, 0x00, 0x00, 0x00, 0x00, 0x00, 0x00, 0x00, 0x00, 0x00, 0x00, 0x00, 0x00, 0x00, 0x00, 0x00
};

// TaskScheduler Object
Scheduler runner;

// Global Variables
bool buttonPressed = false;  // Tracks if the button is pressed
bool displayState = false;   // False = Hide, True = Show
bool otaMode = false;        // Tracks if OTA mode is active
bool data_in = false;
unsigned long bloodStartTime = 0;
// Function Prototypes
void updateLCD();
void handleOTA();
void checkButton();
void checkOTAButton();
void enterOTAMode();
void displayUpdateMode();

// Create Tasks
Task taskUpdateLCD(500, TASK_FOREVER, &updateLCD);   // Blink LCD every 500ms
Task taskHandleOTA(50, TASK_FOREVER, &handleOTA);    // Handle OTA every 50ms
Task taskCheckButton(50, TASK_FOREVER, &checkButton); // Check button every 50ms
Task taskCheckOTAButton(200, TASK_FOREVER, &checkOTAButton); // Check OTA button every 200ms

void setup() 
{
  Serial.begin(115200);
  WiFi.mode(WIFI_STA);
  if (esp_now_init() != 0) {
    Serial.println("Error initializing ESP-NOW");
    return;
  }
  esp_now_set_self_role(ESP_NOW_ROLE_SLAVE);
  esp_now_register_recv_cb(OnDataRecv);

  // LCD Setup
  pinMode(LCD_BACKLIGHT, OUTPUT);
  digitalWrite(LCD_BACKLIGHT, LOW);
  lcd.init();
  lcd.cls();

  // Button Setup
  pinMode(BUTTON_PIN, INPUT_PULLUP); // Use internal pull-up resistor for main button
  pinMode(OTA_BUTTON_PIN, INPUT_PULLUP); // OTA trigger button

  // Register Tasks
  runner.init();
  runner.addTask(taskUpdateLCD);
  runner.addTask(taskHandleOTA);
  runner.addTask(taskCheckButton);
  runner.addTask(taskCheckOTAButton);

  // Start Tasks
  taskUpdateLCD.enable();
  taskHandleOTA.enable();
  taskCheckButton.enable();
  taskCheckOTAButton.enable();
}

void OnDataRecv(uint8_t * mac, uint8_t *incomingData, uint8_t len) {
  memcpy(&myData, incomingData, sizeof(myData));
  data_in = true;
  Serial.print("Bytes received: ");
  Serial.println(len);
  Serial.print("Int: ");
  Serial.println(myData.blood);
  Serial.print("String: ");
  Serial.println(myData.time);
}

// LCD Update Task
void updateLCD() {
  if (otaMode) return; // Do nothing if in OTA mode

  lcd.cls();  // Clear screen before updating

  if (buttonPressed) {
    lcd.drawBitmap(Blood, 0, 0);  // Show Blood bitmap
    Serial.println("Showing Blood Bitmap");
    if (millis() - bloodStartTime >= 5000) {
    Serial.println("Switching to Next Image...");
            lcd.cls();
        lcd.setFont(c64enh);
        lcd.printStr(ALIGN_CENTER, 28, (char*)myData.blood.c_str());
        lcd.printStr(ALIGN_RIGHT, 5, (char*)myData.time.c_str());
    }
  } 
  else if (displayState) {
    lcd.drawBitmap(Black_Strip_Bitmap, 0, 0);  // Show Black_Strip_Bitmap
    Serial.println("Blinking Black Strip Bitmap");
    lcd.setFont(c64enh);
    lcd.printStr(ALIGN_RIGHT, 5, (char*)myData.time.c_str());
  }

  lcd.display();
  displayState = !displayState;  // Toggle state for next cycle
}

// OTA Handling Task
void handleOTA() {
  if (!otaMode) return; // Only handle OTA in update mode
  server.handleClient();
  ElegantOTA.loop();
}

// Button Check Task
void checkButton() {
  if (otaMode) return; // Disable button function in OTA mode

  static bool lastButtonState = HIGH;
  bool buttonState = digitalRead(BUTTON_PIN);

  if (buttonState == LOW && lastButtonState == HIGH) {
    Serial.println("Button Pressed! Showing Blood Bitmap.");
    buttonPressed = true;
    bloodStartTime = millis(); // Start timer for 5 seconds
  } 
  else if (buttonState == HIGH && lastButtonState == LOW) {
    Serial.println("Button Released! Resuming Blinking.");
    buttonPressed = false;
  }

  lastButtonState = buttonState;
}

// Check OTA Button Task
void checkOTAButton() {
  static unsigned long pressStartTime = 0;
  static bool lastButtonState = HIGH;
  bool buttonState = digitalRead(OTA_BUTTON_PIN);

  if (buttonState == LOW && lastButtonState == HIGH) {
    pressStartTime = millis(); // Start counting time
  }
  else if (buttonState == HIGH && lastButtonState == LOW) {
    if (millis() - pressStartTime >= 5000) { // Button held for 5 sec
      enterOTAMode();
    }
  }

  lastButtonState = buttonState;
}

// Enter OTA Mode
void enterOTAMode() {
  Serial.println("Entering OTA Mode...");
    // WiFi Setup
  WiFi.mode(WIFI_STA);
  WiFi.begin(ssid, password);
  while (WiFi.status() != WL_CONNECTED) {
    delay(500);
    Serial.print(".");
  }
  Serial.println("\nConnected to WiFi!");
  Serial.print("IP Address: ");
  Serial.println(WiFi.localIP());

  // OTA Setup
  server.on("/", []() { server.send(200, "text/plain", "Hi! This is ElegantOTA Demo."); });
  ElegantOTA.begin(&server);
  ElegantOTA.onStart(onOTAStart);
  ElegantOTA.onProgress(onOTAProgress);
  ElegantOTA.onEnd(onOTAEnd);
  server.begin();
  Serial.println("HTTP Server started.");
  otaMode = true;

  // Blink LCD backlight 3 times
  for (int i = 0; i < 3; i++) {
    digitalWrite(LCD_BACKLIGHT, HIGH);
    delay(500);
    digitalWrite(LCD_BACKLIGHT, LOW);
    delay(500);
  }

  // Display OTA Update Mode
  displayUpdateMode();

  // Disable regular tasks
  taskUpdateLCD.disable();
  taskCheckButton.disable();

  // Enable OTA task
  taskHandleOTA.enable();
}

// Display "UPDATE MODE: <IP ADDRESS>"
void displayUpdateMode() {
  String ipStr = WiFi.localIP().toString() + "/"+"update";
  lcd.cls();
  lcd.setFont(c64enh);
  lcd.printStr(ALIGN_CENTER, 28, "UPDATE MODE:");
  lcd.printStr(ALIGN_CENTER, 5, (char*)WiFi.macAddress().c_str());
  lcd.printStr(ALIGN_CENTER, 45, (char*)ipStr.c_str());
  lcd.display();
  Serial.println("UPDATE MODE: " + WiFi.localIP().toString());
}

void loop() {
  runner.execute();
}